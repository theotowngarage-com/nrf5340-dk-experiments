## CMakeLists.txt
```
# SPDX-License-Identifier: Apache-2.0

cmake_minimum_required(VERSION 3.13.1)

set(SHIELD adafruit_2_8_tft_touch_v2)

find_package(Zephyr REQUIRED HINTS $ENV{ZEPHYR_BASE})
project(peripheral_otown)

FILE(GLOB app_sources src/*.c src/images/*.c src/fonts/*.c)
target_sources(app PRIVATE ${app_sources})
```

## prj.conf
```kconfig
# Incresed stack due to settings API usage
CONFIG_SYSTEM_WORKQUEUE_STACK_SIZE=2048

CONFIG_BT=y
CONFIG_BT_DEBUG_LOG=y
CONFIG_BT_SMP=y
CONFIG_BT_SIGNING=y
CONFIG_BT_PERIPHERAL=y
CONFIG_BT_DIS=y
CONFIG_BT_ATT_PREPARE_COUNT=5
#CONFIG_BT_BAS=y
#CONFIG_BT_HRS=y
CONFIG_BT_PRIVACY=y
CONFIG_BT_DEVICE_NAME="Otown"
CONFIG_BT_DEVICE_APPEARANCE=833
CONFIG_BT_DEVICE_NAME_DYNAMIC=y
CONFIG_BT_DEVICE_NAME_MAX=65

CONFIG_BT_KEYS_OVERWRITE_OLDEST=y
CONFIG_BT_SETTINGS=y
CONFIG_FLASH=y
CONFIG_FLASH_PAGE_LAYOUT=y
CONFIG_FLASH_MAP=y
CONFIG_NVS=y
CONFIG_SETTINGS=y

##GPIO
CONFIG_GPIO=y

CONFIG_ASSERT=y
CONFIG_LOG=y

# LVGL DISPLAY
CONFIG_HEAP_MEM_POOL_SIZE=16384
CONFIG_MAIN_STACK_SIZE=4096

CONFIG_DISPLAY=y
CONFIG_DISPLAY_LOG_LEVEL_ERR=y

CONFIG_LVGL=y
CONFIG_LVGL_ANTIALIAS=y
CONFIG_LVGL_USE_LABEL=y
CONFIG_LVGL_USE_CONT=y
CONFIG_LVGL_USE_BTN=y
CONFIG_LVGL_USE_CHECKBOX=y
CONFIG_LVGL_USE_IMG=y
CONFIG_LVGL_USE_THEME_MATERIAL=y
CONFIG_LVGL_USE_ANIMATION=y
CONFIG_LVGL_USE_SHADOW=y
CONFIG_LVGL_USE_CHART=y
CONFIG_LVGL_CHART_AXIS_TICK_LABEL_MAX_LEN=256

CONFIG_NEWLIB_LIBC=y
```

## src/main.c
```c
/* main.c - Application main entry point */

/*
 * Copyright (c) 2015-2016 Intel Corporation
 *
 * SPDX-License-Identifier: Apache-2.0
 */
//Zephyr bluetooth stack: https://docs.zephyrproject.org/latest/guides/bluetooth/bluetooth-arch.html

#include <zephyr.h>
#include <settings/settings.h>
#include <bluetooth/bluetooth.h>
#include "gpio.h"
#include "service.h"
#include "gui.h"

// logging module configuration
#define LOG_LEVEL CONFIG_LOG_DEFAULT_LEVEL
#include <logging/log.h>
LOG_MODULE_REGISTER(app);

void on_gui_event(gui_event_t *event) {
  switch (event->evt_type) {
  case GUI_EVT_BUTTON_PRESSED:
    LOG_INF("Button pressed");
    //app_ble_send_button_state(event->button_checked);
    break;
  }
}

void main(void) {
  int err;
  err = bt_enable(NULL);
  if (err) {
    LOG_ERR("Bluetooth init failed (err %d)\n", err);
    return;
  }

  gpio_init();

  LOG_INF("Configuring GUI");
  gui_config_t gui_config = {.event_callback = on_gui_event};
  gui_init(&gui_config);

  LOG_INF("Initialize service, start advertising & initialize callback");
  bt_ready();

  LOG_INF("Application started");
  while (1) {
    k_sleep(K_MSEC(50));
    bt_service_spin();
  }
}
```

## src/RSSI-hci_ctrl.c
```c
// //Controller - from hci_pwr_ctrl
// static struct bt_conn *default_conn;
// static uint16_t default_conn_handle;
// static struct k_thread pwr_thread_data;
// static K_THREAD_STACK_DEFINE(pwr_thread_stack, 320);
// //

// static void read_conn_rssi(uint16_t handle, int8_t *rssi)

// //only read_conn_rssi needed
// void modulate_tx_power(void *p1, void *p2, void *p3)
// {
// 	int8_t txp_get = 0;
// 	uint8_t idx = 0;

// 	while (1) {
// 		if (!default_conn) {
// 			k_sleep(K_SECONDS(5));
// 		} else {
// 			int8_t rssi = 0xFF;
// 			read_conn_rssi(default_conn_handle, &rssi);
// 			printk("Connected (%d) - RSSI = %d\n",
// 			       default_conn_handle, rssi);

// 			k_sleep(K_SECONDS(1));
// 		}
// 	}
// }
// {
// 	struct net_buf *buf, *rsp = NULL;
// 	struct bt_hci_cp_read_rssi *cp;
// 	struct bt_hci_rp_read_rssi *rp;

// 	int err;

// 	buf = bt_hci_cmd_create(BT_HCI_OP_READ_RSSI, sizeof(*cp));
// 	if (!buf) {
// 		printk("Unable to allocate command buffer\n");
// 		return;
// 	}

// 	cp = net_buf_add(buf, sizeof(*cp));
// 	cp->handle = sys_cpu_to_le16(handle);

// 	err = bt_hci_cmd_send_sync(BT_HCI_OP_READ_RSSI, buf, &rsp);
// 	if (err) {
// 		uint8_t reason = rsp ?
// 			((struct bt_hci_rp_read_rssi *)rsp->data)->status : 0;
// 		printk("Read RSSI err: %d reason 0x%02x\n", err, reason);
// 		return;
// 	}

// 	rp = (void *)rsp->data;
// 	*rssi = rp->rssi;

// 	net_buf_unref(rsp);
// }

// static void connected(struct bt_conn *conn, uint8_t err)
// {
// 	char addr[BT_ADDR_LE_STR_LEN];
// 	int ret;
// 	if (err) {
// 		printk("Connection failed (err 0x%02x)\n", err);
// 	} 
// 	else {
// 		default_conn = bt_conn_ref(conn);
// 		ret = bt_hci_get_conn_handle(default_conn,
// 					     &default_conn_handle);
// 		if (ret) {
// 			printk("No connection handle (err %d)\n", ret);
// 		} 
// 		else {
// 			/* Send first at the default selected power */
// 			bt_addr_le_to_str(bt_conn_get_dst(conn),
// 							  addr, sizeof(addr));
// 			printk("Connected via connection (%d)",default_conn_handle);
// 		}
// 	}
// }

// static void disconnected(struct bt_conn *conn, uint8_t reason)
// {
// 	if (default_conn) {
// 		bt_conn_unref(default_conn);
// 		default_conn = NULL;
// 	}
// 	printk("Disconnected (reason 0x%02x)\n", reason);
	
// }

// // k_thread_create(&pwr_thread_data, pwr_thread_stack,
// 	// 		K_THREAD_STACK_SIZEOF(pwr_thread_stack),
// 	// 		modulate_tx_power, NULL, NULL, NULL,
// 	// 		K_PRIO_COOP(10),
// 	// 		0, K_NO_WAIT);
// 	// k_thread_name_set(&pwr_thread_data, "DYN TX");	

// // int8_t rssi = 0xFF;
// 		// read_conn_rssi(default_conn_handle, &rssi);
// 		// printk("Connected (%d) - RSSI = %d\n", default_conn_handle, rssi);
//         // int main(){
//         //     default_conn = NULL;
//         // }
```

## src/auth_service.c
```c
// #include <zephyr/types.h>
// #include <stddef.h>
// #include <string.h>
// #include <errno.h>
// #include <sys/printk.h>
// #include <sys/byteorder.h>
// #include <zephyr.h>

// #include <bluetooth/bluetooth.h>
// #include <bluetooth/hci.h>
// #include <bluetooth/conn.h>
// #include <bluetooth/uuid.h>
// #include <bluetooth/gatt.h>

// #include "auth_service.h"

// //Zephyr's guide https://docs.zephyrproject.org/latest/reference/bluetooth/gatt.html

// //Unique Universal ID of service
// static struct bt_uuid_128 otown_uuid = BT_UUID_INIT_128(
// 	0xf0, 0xde, 0xbc, 0x9a, 0x78, 0x56, 0x34, 0x12,
// 	0x78, 0x56, 0x34, 0x12, 0x78, 0x56, 0x34, 0x12);

// static struct bt_uuid_128 vnd_auth_uuid = BT_UUID_INIT_128(
// 	0xf2, 0xde, 0xbc, 0x9a, 0x78, 0x56, 0x34, 0x12,
// 	0x78, 0x56, 0x34, 0x12, 0x78, 0x56, 0x34, 0x12);

// //Initial value of the service
// static uint8_t otown_value[] = { 'O', ' ', 'T', 'o', 'w', 'n' };

// //Callback function of read command
// static ssize_t read_otown(struct bt_conn *conn, const struct bt_gatt_attr *attr,
// 			void *buf, uint16_t len, uint16_t offset)
// {
//     //pointer to data in GATT structure
// 	const char *value = attr->user_data;

// 	return bt_gatt_attr_read(conn, attr, buf, len, offset, value,
// 				 strlen(value));
// }
// //Callback function of write command
// static ssize_t write_otown(struct bt_conn *conn, const struct bt_gatt_attr *attr,
// 			 const void *buf, uint16_t len, uint16_t offset,
// 			 uint8_t flags)
// {
// 	uint8_t *value = attr->user_data;

// 	if (offset + len > sizeof(otown_value)) {
// 		return BT_GATT_ERR(BT_ATT_ERR_INVALID_OFFSET);
// 	}

// 	memcpy(value + offset, buf, len);

// 	return len;
// }
// //Client Characteristic Configuration.
// static void vnd_ccc_cfg_changed(const struct bt_gatt_attr *attr, uint16_t value) //Client Characterictics Configuration
// {
	
// }

// /* Primary Service Declaration */
// BT_GATT_SERVICE_DEFINE(otown_svc, //create a struct with _name
// 	BT_GATT_PRIMARY_SERVICE(&otown_uuid),
//     BT_GATT_CHARACTERISTIC(&vnd_auth_uuid.uuid,
// 			       BT_GATT_CHRC_READ | BT_GATT_CHRC_WRITE,
// 			       BT_GATT_PERM_READ_AUTHEN |
// 			       BT_GATT_PERM_WRITE_AUTHEN,
// 			       read_otown, write_otown, otown_value),
// 	BT_GATT_CCC(vnd_ccc_cfg_changed,
// 		    BT_GATT_PERM_READ | BT_GATT_PERM_WRITE_ENCRYPT),
// 	);

// static void connected(struct bt_conn *conn, uint8_t err)
// {
// 	if (err) {
// 		printk("Connection failed (err 0x%02x)\n", err);
// 	} else {
// 		printk("Connected\n");
// 	}
// }

// static void disconnected(struct bt_conn *conn, uint8_t reason)
// {
// 	printk("Disconnected (reason 0x%02x)\n", reason);
// }

// static struct bt_conn_cb conn_callbacks = {
// 	.connected = connected,
// 	.disconnected = disconnected,
// };

// static void bt_ready(void)
// {
// 	int err;

// 	printk("Bluetooth initialized\n");

// 	if (IS_ENABLED(CONFIG_SETTINGS)) {
// 		settings_load();
// 	}

// 	err = bt_le_adv_start(BT_LE_ADV_CONN_NAME, ad, ARRAY_SIZE(ad), NULL, 0); //Advertising parameters, data to be advertised and used for response
// 	if (err) {
// 		printk("Advertising failed to start (err %d)\n", err);
// 		return;
// 	}

// 	printk("Advertising successfully started\n");
// }

// //Functioned called when Autharisation is requested
// static void auth_passkey_display(struct bt_conn *conn, unsigned int passkey)
// {
// 	char addr[BT_ADDR_LE_STR_LEN];

// 	bt_addr_le_to_str(bt_conn_get_dst(conn), addr, sizeof(addr));

// 	printk("Passkey for %s: %06u\n", addr, passkey);
// }

// static void auth_cancel(struct bt_conn *conn)
// {
// 	char addr[BT_ADDR_LE_STR_LEN];

// 	bt_addr_le_to_str(bt_conn_get_dst(conn), addr, sizeof(addr));

// 	printk("Pairing cancelled: %s\n", addr);
// }

// //callback in case of autherisation
// static struct bt_conn_auth_cb auth_cb_display = {
// 	.passkey_display = auth_passkey_display,
// 	.passkey_entry = NULL,
// 	.cancel = auth_cancel,
// };
```

## src/gpio.c
```c
/*GPIO*/
#include <drivers/gpio.h>
#include "gpio.h"

/* The devicetree node identifier for the "led0" alias. */
#define LED0_NODE DT_ALIAS(led0)

#if DT_NODE_HAS_STATUS(LED0_NODE, okay)
#define LED0	DT_GPIO_LABEL(LED0_NODE, gpios)
#define PIN	DT_GPIO_PIN(LED0_NODE, gpios)
#define FLAGS	DT_GPIO_FLAGS(LED0_NODE, gpios)
#else
/* A build error here means your board isn't set up to blink an LED. */
#error "Unsupported board: led0 devicetree alias is not defined"
#define LED0	""
#define PIN	0
#define FLAGS	0
#endif

#define RED_LED_PIN 30
#define GREEN_LED_PIN 31

#define GPIO0 DT_GPIO_LABEL(GPIO0)

//GPIO setup
const struct device *dev; 
const struct device *gpio; 

void gpio_init() {
  dev = device_get_binding(LED0);
  if (dev == NULL) {
    printk("error in dev=device_get_binding\n");
    return;
  }
  int ret = gpio_pin_configure(dev, PIN, GPIO_OUTPUT | FLAGS);
  if (ret) {
    printk("Error configuring LED0 pin: %d\n", ret);
  }

  gpio = device_get_binding("GPIO_0");
  if (gpio == NULL) {
    printk("error getting GPIO_0 device\n");
    return;
  }
  ret = gpio_pin_configure(gpio, RED_LED_PIN, GPIO_OUTPUT);
  if(ret) {
    printk("Error configuring pin %d: %d\n", RED_LED_PIN, ret);
  }
  ret = gpio_pin_configure(gpio, GREEN_LED_PIN, GPIO_OUTPUT);
  if(ret) {
    printk("Error configuring pin %d: %d\n", GREEN_LED_PIN, ret);
  }
}

void gpio_set_red(bool on)
{
  if(on) {
      gpio_pin_set(dev, PIN, true);
      gpio_pin_set(gpio, RED_LED_PIN, true);
  } else {
      gpio_pin_set(dev, PIN, false);
      gpio_pin_set(gpio, RED_LED_PIN, false);
  }
}

void gpio_set_green(bool on)
{
  if(on) {
      gpio_pin_set(gpio, GREEN_LED_PIN, true);
  } else {
      gpio_pin_set(gpio, GREEN_LED_PIN, false);
  }
}
```

## src/gpio.h
```c
#ifndef __GPIO_H
#define __GPIO_H
//https://www.tutorialspoint.com/cprogramming/c_header_files.htm

void gpio_init();
void gpio_set_red(bool on);
void gpio_set_green(bool on);

#endif
```

## src/gui.c
```c
#include "gui.h"
#include <device.h>
#include <drivers/display.h>
#include <lvgl.h>
#include <stdio.h>
#include <string.h>
#include <zephyr.h>


#define LOG_LEVEL CONFIG_LOG_DEFAULT_LEVEL
#include <logging/log.h>
LOG_MODULE_REGISTER(gui);

bool gui_initialized = false;
uint32_t count = 0U;
char count_str[11] = {0};
const struct device *display_dev;

static gui_event_t m_gui_event;
static gui_callback_t m_gui_callback = 0;

// Create a message queue for handling external GUI commands
K_MSGQ_DEFINE(m_gui_cmd_queue, sizeof(gui_message_t), 8, 4);

// Define a timer to update the GUI periodically
static void on_gui_blink_timer(struct k_timer *dummy);
K_TIMER_DEFINE(gui_blink_timer, on_gui_blink_timer, NULL);

char *on_off_strings[2] = {"On", "Off"};

// GUI objects
lv_obj_t *top_header;
lv_obj_t *top_header_logo;
lv_obj_t *label_button, *label_led, *label_bt_state_hdr, *label_bt_state;
lv_obj_t *connected_background;
lv_obj_t *label_btn_state, *label_led_state;
lv_obj_t *btn1, *btn1_label;
lv_obj_t *checkbox_led;
lv_obj_t *image_led;
lv_obj_t *image_bg[12];
lv_obj_t *otown_logo;

// Styles
lv_style_t style_btn, style_label, style_label_value, style_checkbox;
lv_style_t style_header, style_con_bg, style_chart, style_series;

// Fonts
LV_FONT_DECLARE(arial_20bold);
LV_FONT_DECLARE(calibri_20b);
LV_FONT_DECLARE(calibri_20);
LV_FONT_DECLARE(calibri_24b);
LV_FONT_DECLARE(calibri_32b);

// Images
//LV_IMG_DECLARE(nod_logo);
//LV_IMG_DECLARE(led_on);
//LV_IMG_DECLARE(led_off);
//LV_IMG_DECLARE(img_noise_background);
LV_IMG_DECLARE(otown_logo_convert); //make image variable (pixel array) visible in the C file


// Data chart
lv_obj_t *chart;
lv_chart_series_t *temperature;

static void gui_show_connected_elements(bool connected);

static void on_button1(lv_obj_t *btn, lv_event_t event) {
  if (btn == btn1) {
    if (event == LV_EVENT_PRESSED) {
      lv_label_set_text(label_btn_state, "Pressed");
      if (m_gui_callback) {
        m_gui_event.evt_type = GUI_EVT_BUTTON_PRESSED;
        m_gui_event.button_checked = true;
        m_gui_callback(&m_gui_event);
      }
    } else if (event == LV_EVENT_RELEASED) {
      lv_label_set_text(label_btn_state, "Released");
      if (m_gui_callback) {
        m_gui_event.evt_type = GUI_EVT_BUTTON_PRESSED;
        m_gui_event.button_checked = false;
        m_gui_callback(&m_gui_event);
      }
    }
  }
}

static void init_styles(void) {
  /*Create background style*/
  static lv_style_t style_screen;
  lv_style_set_bg_color(&style_screen, LV_STATE_DEFAULT, LV_COLOR_MAKE(0xcb, 0xca, 0xff));
  lv_obj_add_style(lv_scr_act(), LV_BTN_PART_MAIN, &style_screen);

  /*Create the screen header label style*/
  lv_style_init(&style_header);
  lv_style_set_bg_opa(&style_header, LV_STATE_DEFAULT, LV_OPA_COVER);
  lv_style_set_bg_color(&style_header, LV_STATE_DEFAULT, LV_COLOR_MAKE(0x1C, 0x11, 0xFD));
  lv_style_set_radius(&style_header, LV_STATE_DEFAULT, 8);
  //lv_style_set_bg_grad_color(&style_header, LV_STATE_DEFAULT, LV_COLOR_TEAL);
  //lv_style_set_bg_grad_dir(&style_header, LV_STATE_DEFAULT, LV_GRAD_DIR_VER);
  lv_style_set_pad_left(&style_header, LV_STATE_DEFAULT, 70);
  lv_style_set_pad_top(&style_header, LV_STATE_DEFAULT, 30);
  lv_style_set_shadow_spread(&style_header, LV_STATE_DEFAULT, 1);
  lv_style_set_shadow_color(&style_header, LV_STATE_DEFAULT, LV_COLOR_BLACK);
  lv_style_set_shadow_opa(&style_header, LV_STATE_DEFAULT, 255);
  lv_style_set_shadow_width(&style_header, LV_STATE_DEFAULT, 1);
  lv_style_set_shadow_ofs_x(&style_header, LV_STATE_DEFAULT, 1);
  lv_style_set_shadow_ofs_y(&style_header, LV_STATE_DEFAULT, 2);
  lv_style_set_shadow_opa(&style_header, LV_STATE_DEFAULT, LV_OPA_50);

  /*Screen header text style*/
  lv_style_set_text_color(&style_header, LV_STATE_DEFAULT, LV_COLOR_MAKE(0x7d, 0xce, 0xfd));
  lv_style_set_text_font(&style_header, LV_STATE_DEFAULT, &calibri_32b);

  lv_style_init(&style_con_bg);
  lv_style_copy(&style_con_bg, &style_header);
  lv_style_set_bg_color(&style_con_bg, LV_STATE_DEFAULT, LV_COLOR_MAKE(0x69, 0xb0, 0x5a));
  lv_style_set_bg_opa(&style_con_bg, LV_STATE_DEFAULT, LV_OPA_50);
  lv_style_set_radius(&style_header, LV_STATE_DEFAULT, 4);

  /*Create a label style*/
  lv_style_init(&style_label);
  lv_style_set_bg_opa(&style_label, LV_STATE_DEFAULT, LV_OPA_COVER);
  lv_style_set_bg_color(&style_label, LV_STATE_DEFAULT, LV_COLOR_SILVER);
  lv_style_set_bg_grad_color(&style_label, LV_STATE_DEFAULT, LV_COLOR_GRAY);
  lv_style_set_bg_grad_dir(&style_label, LV_STATE_DEFAULT, LV_GRAD_DIR_VER);
  lv_style_set_pad_left(&style_label, LV_STATE_DEFAULT, 5);
  lv_style_set_pad_top(&style_label, LV_STATE_DEFAULT, 10);

  /*Add a border*/
  lv_style_set_border_color(&style_label, LV_STATE_DEFAULT, LV_COLOR_WHITE);
  lv_style_set_border_opa(&style_label, LV_STATE_DEFAULT, LV_OPA_70);
  lv_style_set_border_width(&style_label, LV_STATE_DEFAULT, 3);

  /*Set the text style*/
  lv_style_set_text_color(&style_label, LV_STATE_DEFAULT, LV_COLOR_MAKE(0x00, 0x00, 0x30));
  lv_style_set_text_font(&style_label, LV_STATE_DEFAULT, &calibri_20b);

  /*Create a label value style*/
  lv_style_init(&style_label_value);
  lv_style_set_bg_opa(&style_label_value, LV_STATE_DEFAULT, LV_OPA_20);
  lv_style_set_bg_color(&style_label_value, LV_STATE_DEFAULT, LV_COLOR_SILVER);
  lv_style_set_bg_grad_color(&style_label_value, LV_STATE_DEFAULT, LV_COLOR_TEAL);
  lv_style_set_bg_grad_dir(&style_label_value, LV_STATE_DEFAULT, LV_GRAD_DIR_VER);
  lv_style_set_pad_left(&style_label_value, LV_STATE_DEFAULT, 0);
  lv_style_set_pad_top(&style_label_value, LV_STATE_DEFAULT, 3);

  /*Set the text style*/
  lv_style_set_text_color(&style_label_value, LV_STATE_DEFAULT, LV_COLOR_MAKE(0x00, 0x00, 0x30));
  lv_style_set_text_font(&style_label_value, LV_STATE_DEFAULT, &calibri_20);

  /*Create a simple button style*/
  lv_style_init(&style_btn);
  lv_style_set_radius(&style_btn, LV_STATE_DEFAULT, 10);
  lv_style_set_bg_opa(&style_btn, LV_STATE_DEFAULT, LV_OPA_COVER);
  lv_style_set_bg_color(&style_btn, LV_STATE_DEFAULT, LV_COLOR_SILVER);
  lv_style_set_bg_grad_color(&style_btn, LV_STATE_DEFAULT, LV_COLOR_GRAY);
  lv_style_set_bg_grad_dir(&style_btn, LV_STATE_DEFAULT, LV_GRAD_DIR_VER);
  lv_style_set_shadow_spread(&style_btn, LV_STATE_DEFAULT, 1);
  lv_style_set_shadow_color(&style_btn, LV_STATE_DEFAULT, LV_COLOR_GRAY);
  lv_style_set_shadow_opa(&style_btn, LV_STATE_DEFAULT, 255);
  lv_style_set_shadow_width(&style_btn, LV_STATE_DEFAULT, 1);

  /*Swap the colors in pressed state*/
  lv_style_set_bg_color(&style_btn, LV_STATE_PRESSED, LV_COLOR_GRAY);
  lv_style_set_bg_grad_color(&style_btn, LV_STATE_PRESSED, LV_COLOR_SILVER);

  /*Add a border*/
  lv_style_set_border_color(&style_btn, LV_STATE_DEFAULT, LV_COLOR_BLACK);
  lv_style_set_border_opa(&style_btn, LV_STATE_DEFAULT, LV_OPA_70);
  lv_style_set_border_width(&style_btn, LV_STATE_DEFAULT, 3);

  /*Different border color in focused state*/
  lv_style_set_border_color(&style_btn, LV_STATE_FOCUSED, LV_COLOR_BLACK);
  lv_style_set_border_color(&style_btn, LV_STATE_FOCUSED | LV_STATE_PRESSED, LV_COLOR_NAVY);

  /*Set the text style*/
  lv_style_set_text_color(&style_btn, LV_STATE_DEFAULT, LV_COLOR_TEAL);
  lv_style_set_text_font(&style_btn, LV_STATE_DEFAULT, &calibri_24b);

  /*Make the button smaller when pressed*/
  lv_style_set_transform_height(&style_btn, LV_STATE_PRESSED, -4);
  lv_style_set_transform_width(&style_btn, LV_STATE_PRESSED, -8);
#if LV_USE_ANIMATION
  /*Add a transition to the size change*/
  static lv_anim_path_t path;
  lv_anim_path_init(&path);
  lv_anim_path_set_cb(&path, lv_anim_path_overshoot);

  lv_style_set_transition_prop_1(&style_btn, LV_STATE_DEFAULT, LV_STYLE_TRANSFORM_HEIGHT);
  lv_style_set_transition_prop_2(&style_btn, LV_STATE_DEFAULT, LV_STYLE_TRANSFORM_WIDTH);
  lv_style_set_transition_time(&style_btn, LV_STATE_DEFAULT, 300);
  lv_style_set_transition_path(&style_btn, LV_STATE_DEFAULT, &path);
#endif
  lv_style_init(&style_chart);
  lv_style_set_radius(&style_chart, LV_STATE_DEFAULT, 0);
  lv_style_set_bg_opa(&style_chart, LV_STATE_DEFAULT, LV_OPA_COVER);
  lv_style_set_bg_color(&style_chart, LV_STATE_DEFAULT , LV_COLOR_ORANGE);

  lv_style_init(&style_series);
  lv_style_set_size(&style_series, LV_STATE_DEFAULT, 0);
}

void gui_add_point_to_chart(int val) {
  if(gui_initialized) {
    lv_chart_set_next(chart, temperature, (lv_coord_t)val);
    lv_chart_refresh(chart); /*Required after direct set*/

    char s[15];
    snprintk(s, sizeof(s), "RSSI: %d", val);
    lv_label_set_text(label_btn_state, s);
  }
}

static void init_chart_gui(void) {
  /*Create a chart*/
  chart = lv_chart_create(lv_scr_act(), NULL);
  lv_obj_set_size(chart, 320, 150);
  lv_obj_align(chart, NULL, LV_ALIGN_IN_TOP_MID, 0, 0);
  lv_chart_set_type(chart, LV_CHART_TYPE_LINE); /*Show lines and points too*/
  lv_chart_set_point_count(chart, 200);
  lv_chart_set_x_tick_length(chart, 10, 1);
  lv_chart_set_y_range(chart, LV_CHART_AXIS_PRIMARY_Y, -120, -40);
  lv_obj_add_style(chart, LV_CHART_PART_BG, &style_chart);
  lv_obj_add_style(chart, LV_CHART_PART_SERIES, &style_series);

  /* Create last value label */
  label_btn_state = lv_label_create(lv_scr_act(), NULL);
  lv_obj_align(label_btn_state, chart, LV_ALIGN_OUT_BOTTOM_LEFT, 0, 0);
  lv_label_set_long_mode(label_btn_state, LV_LABEL_LONG_DOT);
  lv_label_set_text(label_btn_state, "RSSI: ?");
  lv_label_set_align(label_btn_state, LV_LABEL_ALIGN_LEFT);
  lv_obj_add_style(label_btn_state, LV_LABEL_PART_MAIN, &style_label_value);
  lv_obj_set_size(label_btn_state, 130, 25);


  /*Add two data series*/
  temperature = lv_chart_add_series(chart, LV_COLOR_RED);
}

static void init_blinky_gui(void) {
  //for(int i = 0; i < 12; i++){
  //	int x_index = i % 4;
  //	int y_index = i / 4;
  //	image_bg[i] = lv_img_create(lv_scr_act(), NULL);
  //	lv_obj_set_pos(image_bg[i], x_index*80, y_index*80);
  //	lv_obj_set_size(image_bg[i], 80, 80);
  //	//lv_img_set_src(image_bg[i], &img_noise_background);
  //}

  // The connected header needs to be created before the top_header, to appear behind
  connected_background = lv_label_create(lv_scr_act(), NULL);
  lv_obj_add_style(connected_background, LV_LABEL_PART_MAIN, &style_con_bg);
  lv_label_set_long_mode(connected_background, LV_LABEL_LONG_DOT);
  lv_obj_set_pos(connected_background, 6, 65);
  lv_obj_set_size(connected_background, 308, 135);
  lv_label_set_text(connected_background, "");

  top_header = lv_label_create(lv_scr_act(), NULL);
  lv_obj_add_style(top_header, LV_LABEL_PART_MAIN, &style_header);
  lv_label_set_long_mode(top_header, LV_LABEL_LONG_DOT);
  lv_obj_set_pos(top_header, 3, 3);
  lv_obj_set_size(top_header, 314, 68);
  lv_label_set_text(top_header, "OTG Blinky");
  //lv_label_set_align(top_header, LV_LABEL_ALIGN_CENTER);

  //top_header_logo = lv_img_create(lv_scr_act(), NULL);
  //lv_obj_set_pos(top_header_logo, 0, 0);
  //lv_obj_set_size(top_header_logo, 68, 68);
  //lv_img_set_src(top_header_logo, &nod_logo);

  label_bt_state = lv_label_create(lv_scr_act(), NULL);
  lv_label_set_long_mode(label_bt_state, LV_LABEL_LONG_CROP);
  lv_label_set_align(label_bt_state, LV_LABEL_ALIGN_CENTER);
  lv_obj_set_pos(label_bt_state, 70, 210);
  lv_obj_set_size(label_bt_state, 180, 30);
  lv_label_set_text(label_bt_state, "Idle");
  lv_obj_add_style(label_bt_state, LV_LABEL_PART_MAIN, &style_label_value);

  btn1 = lv_btn_create(lv_scr_act(), NULL);        /*Add a button the current screen*/
  lv_obj_set_pos(btn1, 10, 90);                    /*Set its position*/
  lv_obj_set_size(btn1, 120, 50);                  /*Set its size*/
  lv_obj_reset_style_list(btn1, LV_BTN_PART_MAIN); /*Remove the styles coming from the theme*/
  lv_obj_add_style(btn1, LV_BTN_PART_MAIN, &style_btn);
  lv_btn_set_checkable(btn1, true);

  btn1_label = lv_label_create(btn1, NULL); /*Add a label to the button*/
  lv_label_set_text(btn1_label, "Button");  /*Set the labels text*/
  lv_obj_set_event_cb(btn1, on_button1);

  label_btn_state = lv_label_create(lv_scr_act(), NULL);
  lv_label_set_long_mode(label_btn_state, LV_LABEL_LONG_DOT);
  lv_obj_set_pos(label_btn_state, 10, 170);
  lv_obj_set_size(label_btn_state, 120, 25);
  lv_label_set_text(label_btn_state, "Released");
  lv_label_set_align(label_btn_state, LV_LABEL_ALIGN_CENTER);
  lv_obj_add_style(label_btn_state, LV_LABEL_PART_MAIN, &style_label_value);

  //image_led = lv_img_create(lv_scr_act(), NULL);
  //lv_obj_set_pos(image_led, 192, 68);
  //lv_obj_set_size(image_led, 68, 68);
  //lv_img_set_src(image_led, &led_off);

  label_led_state = lv_label_create(lv_scr_act(), NULL);
  lv_label_set_long_mode(label_led_state, LV_LABEL_LONG_DOT);
  lv_obj_set_pos(label_led_state, 170, 170);
  lv_obj_set_size(label_led_state, 120, 25);
  lv_label_set_text(label_led_state, "Off");
  lv_label_set_align(label_led_state, LV_LABEL_ALIGN_CENTER);
  lv_obj_add_style(label_led_state, LV_LABEL_PART_MAIN, &style_label_value);

  gui_show_connected_elements(true);
}

static void gui_show_connected_elements(bool connected) {
  lv_obj_set_hidden(connected_background, !connected);
  lv_obj_set_hidden(btn1, !connected);
  lv_obj_set_hidden(label_btn_state, !connected);
  //lv_obj_set_hidden(image_led, !connected);
  lv_obj_set_hidden(label_led_state, !connected);
}

static void set_bt_state(gui_bt_state_t state) {
  bool connected = false;
  switch (state) {
  case GUI_BT_STATE_IDLE:
    k_timer_stop(&gui_blink_timer);
    lv_label_set_text(label_bt_state, "Idle");
    break;
  case GUI_BT_STATE_ADVERTISING:
    k_timer_start(&gui_blink_timer, K_MSEC(500), K_MSEC(500));
    lv_label_set_text(label_bt_state, "Advertising");
    break;
  case GUI_BT_STATE_CONNECTED:
    k_timer_stop(&gui_blink_timer);
    lv_label_set_text(label_bt_state, "Connected");
    connected = true;
    break;
  }
  gui_show_connected_elements(connected);
}

static void on_gui_blink_timer(struct k_timer *dummy) {
  static bool blink_state;
  blink_state = !blink_state;
  lv_label_set_text(label_bt_state, blink_state ? "Advertising" : "");
}

void gui_init(gui_config_t *config) {
  m_gui_callback = config->event_callback;
}

void gui_set_bt_state(gui_bt_state_t state) {
  static gui_message_t set_bt_state_msg;
  set_bt_state_msg.type = GUI_MSG_SET_BT_STATE;
  set_bt_state_msg.params.bt_state = state;
  k_msgq_put(&m_gui_cmd_queue, &set_bt_state_msg, K_NO_WAIT);
}

void gui_set_bt_led_state(bool led_is_on) {
  static gui_message_t set_led_state_msg;
  set_led_state_msg.type = GUI_MSG_SET_LED_STATE;
  set_led_state_msg.params.led_state = led_is_on;
  k_msgq_put(&m_gui_cmd_queue, &set_led_state_msg, K_NO_WAIT);
}

static void process_cmd_msg_queue(void) {
  gui_message_t cmd_message;
  while (k_msgq_get(&m_gui_cmd_queue, &cmd_message, K_NO_WAIT) == 0) {
    // Process incoming commands depending on type
    switch (cmd_message.type) {
    case GUI_MSG_SET_STATE:
      break;
    case GUI_MSG_SET_BT_STATE:
      set_bt_state(cmd_message.params.bt_state);
      break;
    case GUI_MSG_SET_LED_STATE:
      //lv_img_set_src(image_led, cmd_message.params.led_state ? &led_on : &led_off);
      lv_label_set_text(label_led_state, cmd_message.params.led_state ? "On" : "Off");
      break;
    }
  }
}

//O'Town Image Logo configuration
void lv_img_logo(void)
{
    otown_logo = lv_img_create(lv_scr_act(), NULL); //some HAL function
    lv_obj_set_pos(otown_logo, 320-90, 240-90);
    //lv_obj_set_size(otown_logo, 90, 90);
    lv_img_set_src(otown_logo, &otown_logo_convert); //source the image
}

void gui_run(void) {
  display_dev = device_get_binding(CONFIG_LVGL_DISPLAY_DEV_NAME);

  if (display_dev == NULL) {
    LOG_ERR("Display device not found!");
    return;
  }

  init_styles();

  init_chart_gui();
  lv_img_logo();
  display_blanking_off(display_dev);

  gui_initialized = true;

  while (1) {
    process_cmd_msg_queue();
    lv_task_handler();
    k_sleep(K_MSEC(20));
  }
}

// Define our GUI thread, using a stack size of 4096 and a priority of 7
K_THREAD_DEFINE(gui_thread, 4096, gui_run, NULL, NULL, NULL, 7, 0, 0);
```

## src/gui.h
```c
#ifndef __GUI_H
#define __GUI_H

#include <zephyr.h>

typedef enum {GUI_EVT_BUTTON_PRESSED} gui_event_type_t;

typedef enum {GUI_BT_STATE_IDLE, GUI_BT_STATE_ADVERTISING, GUI_BT_STATE_CONNECTED} gui_bt_state_t;

typedef struct
{
	gui_event_type_t evt_type;
	bool button_checked;
} gui_event_t;

typedef enum  {GUI_MSG_SET_STATE, GUI_MSG_SET_BT_STATE, GUI_MSG_SET_LED_STATE} gui_msg_type_t;

typedef struct
{
	gui_msg_type_t type;
	void *p_data;
	union 
	{
		gui_bt_state_t bt_state;
		bool led_state;
	} params;
} gui_message_t;


typedef void (*gui_callback_t)(gui_event_t *event);

typedef struct
{
	gui_callback_t event_callback;
} gui_config_t;

void gui_init(gui_config_t * config);

void gui_update(void);

void gui_set_bt_state(gui_bt_state_t state);

void gui_set_bt_led_state(bool led_on);

void gui_add_point_to_chart(int val);

#endif
```

## src/service.c
```c
#include <errno.h>
#include <stddef.h>
#include <stdint.h> //pointer to integer
#include <string.h>
#include <stdlib.h>
#include <sys/byteorder.h>
#include <sys/printk.h>
#include <zephyr.h>
#include <zephyr/types.h>

#include <bluetooth/bluetooth.h>
#include <bluetooth/conn.h>
#include <bluetooth/gatt.h>
#include <bluetooth/hci.h>
#include <bluetooth/uuid.h>
#include <settings/settings.h>

#include "gpio.h"
#include "service.h"
#include "gui.h"

// logging module configuration
#define LOG_LEVEL CONFIG_LOG_DEFAULT_LEVEL
#include <logging/log.h>
LOG_MODULE_REGISTER(service);

//Zephyr's guide https://docs.zephyrproject.org/latest/reference/bluetooth/gatt.html

//Unique Universal ID of service
#define OTOWN_UUID                      BT_UUID_DECLARE_128(BT_UUID_128_ENCODE(0x39342d62, 0x3932, 0x662d, 0x6538, 0x313134343332))
#define REMOTE_RSSI_CHARACTERISTIC_UUID BT_UUID_DECLARE_128(BT_UUID_128_ENCODE(0x63342d31, 0x3836, 0x372d, 0x3166, 0x306331633562))
#define DETACH_CHARACTERISTIC_UUID      BT_UUID_DECLARE_128(BT_UUID_128_ENCODE(0x1e086d95, 0x7faa, 0x4993, 0x984e, 0xcf234cec373b))

#define DETACH_COMMAND "detach"
#define RSSI_HISTORY_LENGTH 4

//Initial value of the service
static uint8_t otown_value[16];
static char detach_request[16];
static bool detached_safely = false;
static int rssi_history[RSSI_HISTORY_LENGTH];

// Queue for passing received RSSI values to main thread
K_MSGQ_DEFINE(rssi_queue, sizeof(int), 4, 4);

void rssi_clear() {
  for(uint8_t i = 0; i < RSSI_HISTORY_LENGTH; i++) {
    rssi_history[i] = INT_MAX;
  }
}

void rssi_add(int rssi) {
  for(uint8_t i = 1; i < RSSI_HISTORY_LENGTH; i++) {
    rssi_history[i - 1] = rssi_history[i];
  }
  rssi_history[RSSI_HISTORY_LENGTH - 1] = rssi;
}

int rssi_max() {
  int min_rssi = INT_MIN;
  for(uint8_t i = 0; i < RSSI_HISTORY_LENGTH; i++) {
    min_rssi = rssi_history[i] > min_rssi ? rssi_history[i] : min_rssi;
  }
  return min_rssi;
}

static ssize_t read_otown(struct bt_conn *conn, const struct bt_gatt_attr *attr,
    void *buf, uint16_t len, uint16_t offset) {
  //pointer to data in GATT structure
  const char *value = attr->user_data;

  return bt_gatt_attr_read(conn, attr, buf, len, offset, value,
      strlen(value));
}

//Callback function of write command
static ssize_t write_otown(struct bt_conn *conn, const struct bt_gatt_attr *attr,
    const void *buf, uint16_t len, uint16_t offset,
    uint8_t flags) {
  uint8_t *value = attr->user_data;

  if (offset + len > sizeof(otown_value)) {
    return BT_GATT_ERR(BT_ATT_ERR_INVALID_OFFSET);
  }
  memcpy(value + offset, buf, len);

  // Print raw value
  LOG_INF("Value = %s", log_strdup(value));

  int value_int = atoi(value);

  k_msgq_put(&rssi_queue, &value_int, K_NO_WAIT);
  return len;
}

static ssize_t write_detach(struct bt_conn *conn, const struct bt_gatt_attr *attr,
    const void *buf, uint16_t len, uint16_t offset,
    uint8_t flags) {
  uint8_t *value = attr->user_data;

  if (offset + len > sizeof(detach_request)) {
    return BT_GATT_ERR(BT_ATT_ERR_INVALID_OFFSET);
  }
  memcpy(value + offset, buf, len);

  //Print value
  LOG_INF("Detach = %s", log_strdup(value));

  if(strncmp(value, DETACH_COMMAND, strlen(DETACH_COMMAND)) == 0) {
    LOG_INF("Detaching from phone\n");
    detached_safely = true;
  }

  return len;
}

//Client Characteristic Configuration.
static void vnd_ccc_cfg_changed(const struct bt_gatt_attr *attr, uint16_t value) //Client Characterictics Configuration
{
}

/* Primary Service Declaration */
BT_GATT_SERVICE_DEFINE(otown_svc,               //create a struct with _name
    BT_GATT_PRIMARY_SERVICE(OTOWN_UUID),       //Main UUID
    BT_GATT_CHARACTERISTIC(REMOTE_RSSI_CHARACTERISTIC_UUID,  //Charasteristics attribute UUID
        BT_GATT_CHRC_READ | BT_GATT_CHRC_WRITE,   //Properties
        BT_GATT_PERM_READ | BT_GATT_PERM_WRITE, // permissions read/write no security
        read_otown, write_otown, otown_value),  //Callback functions and value
    BT_GATT_CHARACTERISTIC(DETACH_CHARACTERISTIC_UUID,  //Charasteristics attribute UUID
        BT_GATT_CHRC_WRITE,   //Properties
        BT_GATT_PERM_WRITE, // permissions read/write no security
        NULL, write_detach, detach_request),  //Callback functions and value
    BT_GATT_CCC(vnd_ccc_cfg_changed,            //Client Configuration Configuration
        BT_GATT_PERM_READ | BT_GATT_PERM_WRITE_ENCRYPT),
        );

//Advertising address
static const struct bt_data advertising_data[] = {
    BT_DATA_BYTES(BT_DATA_FLAGS, (BT_LE_AD_GENERAL | BT_LE_AD_NO_BREDR)),
    // last service advertised UUID
    BT_DATA_BYTES(BT_DATA_UUID128_ALL, BT_UUID_128_ENCODE(0x39342d62, 0x3932, 0x662d, 0x6538, 0x313134343332)),
    // this doesn't work, advertising fails -22
    //BT_DATA_BYTES(BT_DATA_NAME_COMPLETE, 'O', ' ', 'T', 'o', 'w', 'n'),
};

static void connected(struct bt_conn *conn, uint8_t err) {
  if (err) {
    LOG_ERR("Connection failed (err 0x%02x)\n", err);
  } else {
    LOG_INF("Connected\n");
  }
  detached_safely = false;
  rssi_clear();
}

static void disconnected(struct bt_conn *conn, uint8_t reason) {
  LOG_INF("Disconnected (reason 0x%02x)\n", reason);
  // turn on red leds if remote device did not detach safely before disconnecting
  if(!detached_safely) {
    gpio_set_red(true);
  }
}

static struct bt_conn_cb conn_callbacks = {
    .connected = connected,
    .disconnected = disconnected,
};

void bt_ready(void) {
  int err;

  LOG_INF("Bluetooth initialized\n");

  if (IS_ENABLED(CONFIG_SETTINGS)) {
    settings_load();
  }

  // register connect and disonnect callbacks
  bt_conn_cb_register(&conn_callbacks);

  err = bt_le_adv_start(BT_LE_ADV_CONN_NAME, advertising_data, ARRAY_SIZE(advertising_data), NULL, 0); //Advertising parameters, data to be advertised and used for response
  if (err) {
    LOG_ERR("Advertising failed to start (err %d)\n", err);
    return;
  }
  LOG_INF("Advertising successfully started\n");
}

void bt_service_spin() {
    gpio_set_green(false);
    int rssi;
    if(k_msgq_get(&rssi_queue, &rssi, K_NO_WAIT) == 0) {
      LOG_INF("RSSI = %d", rssi);
      gui_add_point_to_chart(rssi);
      rssi_add(rssi);
      if(rssi_max() < -80) {
        gpio_set_red(true);
      } else {
        gpio_set_red(false);
        gpio_set_green(true);
      }
    }
}
```

## src/service.h
```c
/** @file
 *  @brief Service sample*/

#ifdef __cplusplus
extern "C" {
#endif

void bt_ready(void);
void bt_service_spin();


#ifdef __cplusplus
}
#endif
```
